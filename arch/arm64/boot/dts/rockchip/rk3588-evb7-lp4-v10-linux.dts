// SPDX-License-Identifier: (GPL-2.0+ OR MIT)
/*
 * Copyright (c) 2022 Rockchip Electronics Co., Ltd.
 *
 */

/dts-v1/;

#include "rk3588-evb7-lp4.dtsi"
#include "rk3588-linux.dtsi"

/ {
	model = "SYF";
	compatible = "rockchip,rk3588-SYF", "rockchip,rk3588";
};
